## arch/arm/src/r328/drivers/board/xr829/Kconfig
```kconfig
menuconfig DRIVERS_XRADIO
	default n
	bool "xr829 driver"

if DRIVERS_XRADIO

config DRIVER_XR829
	bool "Enable xr829 driver"
	default n

endif
```

## arch/arm/src/r328/drivers/board/xradio/Kconfig
```kconfig
menuconfig DRIVERS_XRADIO
	default n
	bool "XRADIO driver"

if DRIVERS_XRADIO
choice XRADIO_CHIP
	default DRIVER_XR829
	prompt "Xradio chip"
	help
		Specify the xradio chip.

config DRIVER_XR819
	bool "Enable xr819 driver"
	help
		this will use xr819 chip.

config DRIVER_XR829
	bool "Enable xr829 driver"
	help
		this will use xr829 chip.

endchoice
endif
```

## arch/arm/src/r328/drivers/chip-src/Kconfig
```kconfig
source arch/arm/src/r328/drivers/chip-src/sound/Kconfig
source arch/arm/src/r328/drivers/chip-src/ccmu/Kconfig
source arch/arm/src/r328/drivers/chip-src/efuse/Kconfig
source arch/arm/src/r328/drivers/chip-src/thermal/Kconfig
source arch/arm/src/r328/drivers/chip-src/pwm/Kconfig
source arch/arm/src/r328/drivers/chip-src/spi/Kconfig
source arch/arm/src/r328/drivers/chip-src/dma/Kconfig
source arch/arm/src/r328/drivers/chip-src/gpio/Kconfig
source arch/arm/src/r328/drivers/chip-src/lradc/Kconfig
source arch/arm/src/r328/drivers/chip-src/gpadc/Kconfig
source arch/arm/src/r328/drivers/chip-src/i2c/Kconfig
source arch/arm/src/r328/drivers/chip-src/sdmmc/Kconfig
source arch/arm/src/r328/drivers/chip-src/usb/Kconfig
```

## arch/arm/src/r328/drivers/chip-src/ce/Kconfig
```kconfig
menuconfig DRIVERS_CE
	bool "sunxi crypto engine driver"
	default n
	---help---
		Support sunxi crypto engine.

if DRIVERS_CE

config DRIVERS_CE_TEST
	bool "CryptoEngine test"
	default n

endif
```

## arch/arm/src/r328/drivers/chip-src/dma/Kconfig
```kconfig
menu "DMA Devices"

config DRIVERS_DMA
    bool "enable dma device drivers"
        default y


config DRIVERS_DMA_TEST
    bool "dma test"
    default n

endmenu
```

## arch/arm/src/r328/drivers/chip-src/efuse/Kconfig
```kconfig
menu "Efuse Devices"

config DRIVERS_EFUSE
    bool "enable  efuse device driver"
        default y

menu "efuse option featuers"

config DRIVERS_EFUSE_TEST
    bool "efuse test"
        select DRIVERS_EFUSE
        default n

endmenu

endmenu
```

## arch/arm/src/r328/drivers/chip-src/gpadc/Kconfig
```kconfig
menu "Gpadc Devices"

config DRIVERS_GPADC
    bool "enable  gpadc device driver"
        default y

endmenu
```

## arch/arm/src/r328/drivers/chip-src/i2c/Kconfig
```kconfig
menu "I2C Devices"

config DRIVERS_I2C
    bool "enable i2c device driver"
        default y

endmenu
```

## arch/arm/src/r328/drivers/chip-src/lradc/Kconfig
```kconfig
menu "Lradc Devices"

config DRIVERS_LRADC
    bool "enable  lradc device driver"
        default n

endmenu
```

## arch/arm/src/r328/drivers/chip-src/pwm/Kconfig
```kconfig
menu "PWM Devices"
	config DRIVERS_PWM
	    bool "enable pwm device drivers"
	    default n
	
	config USING_PWM_DRIVER_OPS
	    bool "using pwm device drivers struct"
		depends on DRIVERS_PWM
	    default y
		help
		"This option provides a data structure that "
		"contains all the driver operations"

	menu "pwm driver debug option features"
		config PWM_DBG
		    bool "enable macro PWM_DBG"
		    depends on DRIVERS_PWM
		    default n
			help
			"Debugging info function configuration"
		
		config PWM_ERR
		    bool "enable macro PWM_ERR"
		    depends on DRIVERS_PWM
		    default n
			help
			"Debugging error function configuration"
		
		config PWM_TRACE
		    bool "enable macro PWM_TRACE"
		    depends on DRIVERS_PWM
		    default n
			help
			"Debugging trace function configuration"

	endmenu
endmenu
```

## arch/arm/src/r328/drivers/chip-src/sdmmc/Kconfig
```kconfig
menu "SDMMC Devices"

config DRIVERS_SDMMC
    bool "enable SDMMC drivers"
        default n

if DRIVERS_SDMMC

config USE_SD
	bool "enable SD"
	default y

config USE_SDIO
	bool "enable SDIO"
	default y

config USE_MMC
	bool "enable mmc"
	default n

config DETECT_CARD
    bool "enable detect card"
    default y

config SDC_DMA_USED
	bool "enable dma transmission"
	default n

config SDIO_IRQ
	bool "enable sdio irq"
	default n

endif
endmenu
```

## arch/arm/src/r328/drivers/chip-src/sound/Kconfig
```kconfig
menuconfig DRIVERS_SOUND
	bool "Sound card support"
	default n

if DRIVERS_SOUND

source arch/arm/src/r328/drivers/chip-src/sound/codecs/Kconfig
source arch/arm/src/r328/drivers/chip-src/sound/platform/Kconfig

endif # DRIVERS_SOUND
```

## arch/arm/src/r328/drivers/chip-src/sound/codecs/Kconfig
```kconfig
menu "CODEC drivers"

config SND_CODEC_COMMON
	bool
	default n

config SND_CODEC_DUMMY
	bool "dummy codec"
	default n

config SND_CODEC_AC107
	bool "X-powers AC108 codec"
	select SND_CODEC_COMMON
	default n

source arch/arm/src/r328/drivers/chip-src/sound/codecs/sunxi-codec/Kconfig

endmenu
```

## arch/arm/src/r328/drivers/chip-src/sound/codecs/sunxi-codec/Kconfig
```kconfig
config SND_CODEC_SUNXI_RWFUNC
	bool
	default n

config SND_CODEC_SUN8IW18_AUDIOCODEC
	bool "Allwinner sun8iw18 AudioCodec support"
	default n
	select SND_PLATFORM_SUNXI_CPUDAI
	select SND_CODEC_SUNXI_RWFUNC
	depends on ARCH_SUN8IW18P1
	help
	  Select Y to add support the Codec embedded in the Allwinner
	  sun8iw18 and affiliated SoCs.
```

## arch/arm/src/r328/drivers/chip-src/sound/platform/Kconfig
```kconfig
menu "Platform(Audio Interface) drivers"

config SND_PLATFORM_SUNXI_PCM
	bool
	default n

config SND_PLATFORM_SUNXI_CPUDAI
	bool "Allwinner internal cpudai"
	select SND_PLATFORM_SUNXI_PCM
	default n
	help
	  Only support for the Codec embedded in the Allwinner SoCs.

config SND_PLATFORM_SUNXI_DAUDIO
	bool "Allwinner Digital Audio Support"
	select SND_PLATFORM_SUNXI_PCM
	default n
	help
	  Select Y to add support for I2S/PCM/TDM module in Allwinner SoCs.

config SND_PLATFORM_SUNXI_DMIC
	bool "Allwinner DMIC Support"
	select SND_PLATFORM_SUNXI_PCM
	default n
	help
	  Select Y to add support for DMIC module in Allwinner SoCs.

endmenu
```

## arch/arm/src/r328/drivers/chip-src/spi/Kconfig
```kconfig
menu "SPI Devices"

config DRIVERS_SPI
    bool "SPI support"
    select SCHED_WORKQUEUE
    select SCHED_HPWORK
    select SCHED_LPWORK
    default y

if DRIVERS_SPI

config SUNXI_SPI0
    bool "enable spi0"
    default y

config SUNXI_SPI1
    bool "enable spi1"
    default n

config SUNXI_SPI2
    bool "enable spi2"
    default n

config DRIVERS_SPI_TEST
    bool "spi test"
    default n

endif

endmenu
```

## arch/arm/src/r328/drivers/chip-src/spinor/Kconfig
```kconfig
menu "SPINOR Devices"

config DRIVERS_SPINOR
    bool "enable spinor device drivers"
        default y

endmenu
```

## arch/arm/src/r328/drivers/chip-src/thermal/Kconfig
```kconfig
menu "THERMAL Devices"

config DRIVERS_THERMAL
    bool "enable thermal device drivers"
        default n

endmenu
```

## arch/arm/src/r328/drivers/chip-src/usb/Kconfig
```kconfig
menu "USB Devices"
source "arch/arm/src/r328/drivers/chip-src/usb/udc/Kconfig"
source "arch/arm/src/r328/drivers/chip-src/usb/gadget/Kconfig"
endmenu
```
