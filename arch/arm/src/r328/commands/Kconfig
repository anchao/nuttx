## arch/arm/src/r328/commands/adb/Kconfig
```kconfig
menu "ADB Commands"

config EXAMPLES_AWC_ADBD
	bool "AW adbd service"
	depends on COMPONENTS_USB_GADGET_ADBD
	default n
	help
	  adbd service for Allwinner RTOS.

config EXAMPLES_AWC_ADB_FORWARD
	bool "AW adb forward command"
	depends on COMPONENTS_USB_GADGET_ADB_FORWARD
	default n
	help
	  support af(adb forward) command, used to forward data via adb protocol.

endmenu
```

## arch/arm/src/r328/commands/debug/Kconfig
```kconfig
menu "Debug Commands"

config EXAMPLES_AWC_WATCHPOINT
	bool "AW watchpoint command"
	depends on DEBUG_WATCHPOINT
	default y
	help
	  command to set hardware watchpoint for debug.

config EXAMPLES_AWC_BREAKPOINT
	bool "AW breakpoint command"
	depends on DEBUG_WATCHPOINT
	default y
	help
	  command to set hardware breakpoint for debug.

endmenu
```

## arch/arm/src/r328/commands/iobox/Kconfig
```kconfig
menu "IOBOX Commands"

config EXAMPLES_AWC_RWCHECK
	bool "AW rwcheck command"
	depends on DRIVERS_SPINOR
	default n
	help
	  read/write check command for flash.

config EXAMPLES_AWC_RWSPEED
	bool "AW rwspeed command"
	depends on DRIVERS_SPINOR
	default n
	help
	  command for calculating read/write rates.

endmenu
```

## arch/arm/src/r328/commands/sound/Kconfig
```kconfig
menu "Audio Commands"

config EXAMPLES_AWC_APLAY
	bool "AW alsa utils aplay"
	depends on COMPONENTS_AW_ALSA_UTILS
	default n
	help
	  aplay command can be used on the command line. It can play music with wav files.

config EXAMPLES_AWC_ARECORD
	bool "AW alsa utils arecord"
	depends on COMPONENTS_AW_ALSA_UTILS
	default n
	help
	  arecord command can be used on the command line. It is a record demo.

config EXAMPLES_AWC_AMIXER
	bool "AW alsa utils amixer"
	depends on COMPONENTS_AW_ALSA_UTILS
	default n
	help
	  amixer command can be used on the command line.

config EXAMPLES_AWC_SOUNDCARD
	bool "AW alsa utils soundcard"
	depends on COMPONENTS_AW_ALSA_UTILS
	default n
	help
	  soundcard command can be used on the command line.
endmenu
```

## arch/arm/src/r328/components/Kconfig
```kconfig
comment "system components"

menu "aw components"

config COMPONENTS_AW
    bool
    default y

source arch/arm/src/r328/components/aw/Kconfig

endmenu

menu "thirdparty components"

config COMPONENTS_THIRDPARTY
    bool
    default y

source arch/arm/src/r328/components/thirdparty/Kconfig

endmenu
```

## arch/arm/src/r328/components/aw/Kconfig
```kconfig
source arch/arm/src/r328/components/aw/sound/Kconfig
source arch/arm/src/r328/components/aw/usb/Kconfig
source arch/arm/src/r328/components/aw/wifi/Kconfig
```

## arch/arm/src/r328/components/aw/bluetooth/Kconfig
```kconfig
#
# For a description of the syntax of this configuration file,
# see the file kconfig-language.txt in the NuttX tools repository.
#

menu "AW BT Compenents"
config COMPONENTS_AW_BT
	bool "Allwinner bt manager"
	default n
	help
		this is bt manager.
endmenu
```

## arch/arm/src/r328/components/aw/debug/Kconfig
```kconfig
menu "Debug Components Support"
config DEBUG_WATCHPOINT
    bool "Debug Watchpoint"
	default y
	help
	    "Enable Debug Components Watchpoint"
endmenu
```

## arch/arm/src/r328/components/aw/sound/Kconfig
```kconfig
menu "AW Sound Compenents"
	depends on DRIVERS_SOUND

config COMPONENTS_AW_ALSA_LIB
	bool "Allwinner alsa library"
	default n
	help
	  This is library package for aw-alsa, only used for Allwinner Tina RTOS.

config COMPONENTS_AW_ALSA_UTILS
	bool "Allwinner alsa utilities"
	depends on COMPONENTS_AW_ALSA_LIB
	default n
	help
	  This is package for aw-alsa-lib utilities, only used for Allwinner Tina RTOS.

config BUILTIN_WAV_FILE
	bool "builtin wav file"
	depends on COMPONENTS_AW_ALSA_UTILS
	default y
	help
	  Say Y to use builtin wav file.
endmenu
```

## arch/arm/src/r328/components/aw/usb/Kconfig
```kconfig
menu "USB Components Support"
source arch/arm/src/r328/components/aw/usb/gadget/Kconfig
endmenu
```

## arch/arm/src/r328/components/aw/usb/gadget/Kconfig
```kconfig
menu "USB Gadget Support"
source arch/arm/src/r328/components/aw/usb/gadget/demo/Kconfig
source arch/arm/src/r328/components/aw/usb/gadget/adbd/Kconfig
endmenu
```

## arch/arm/src/r328/components/aw/usb/gadget/adbd/Kconfig
```kconfig
config COMPONENTS_USB_GADGET_ADBD
    bool "adbd service"
    select DRIVERS_USB_UDC
    select DRIVERS_USB_GADGET
    select DRIVERS_USB_GADGET_ADB
    select DRIVERS_EFUSE
    default n
    help
	adbd service

config COMPONENTS_USB_GADGET_ADB_FORWARD
    bool "adb forward function"
    default n
    depends on  COMPONENTS_USB_GADGET_ADBD && NET
```

## arch/arm/src/r328/components/aw/usb/gadget/demo/Kconfig
```kconfig
config COMPONENTS_USB_GADGET_DEMO
    bool "USB Gadget Demo Application"
    select DRIVERS_USB_UDC
    default n
    help
	It's a usb gadget demo to show how to use the hal API.
        If unsure, say N.
```

## arch/arm/src/r328/components/aw/wifi/Kconfig
```kconfig
#
# For a description of the syntax of this configuration file,
# see the file kconfig-language.txt in the NuttX tools repository.
#

menu "AW Wifi Compenents"
config COMPONENTS_AW_WIFI
	bool "Allwinner wifi manager"
	default n
	help
		this is wifi manager.
endmenu
```

## arch/arm/src/r328/components/thirdparty/Kconfig
```kconfig
source arch/arm/src/r328/components/thirdparty/opus/Kconfig
source arch/arm/src/r328/components/thirdparty/env/Kconfig
```

## arch/arm/src/r328/components/thirdparty/env/Kconfig
```kconfig
menuconfig COMPONENTS_ENV
    bool "env support"
    default y
    help
      support read write env
      If unsure, say Y.

if COMPONENTS_ENV

    config COMPONENTS_ENV_SIZE
    int "Env Size (bytes)"
    default 4096
    help
        Size of env in bytes.

endif
```

## arch/arm/src/r328/components/thirdparty/opus/Kconfig
```kconfig
menuconfig COMPONENTS_OPUS
    bool "opus audio codec"
    default y
    help
      support Opus audio codec

if COMPONENTS_OPUS

    config COMPONENTS_OPUS_DECODE_TEST
    bool "OPUS decoder test"
    default n
    help
      An example tests the opus decoder interface.

    config COMPONENTS_OPUS_ENCODE_TEST
    bool "OPUS encoder test"
    default n
    help
      An example tests the opus encoder interface.
endif
```

## arch/arm/src/r328/drivers/Kconfig
```kconfig
comment "Configure all required driver sub-systems"

menu "soc related device drivers"

config DRIVERS_CHIP
	bool
	default y

source arch/arm/src/r328/drivers/chip-src/Kconfig

endmenu

menu "board related device drivers"

config DRIVERS_BOARD
	bool
	default y

source arch/arm/src/r328/drivers/board/Kconfig

endmenu
```

## arch/arm/src/r328/drivers/board/Kconfig
```kconfig
source arch/arm/src/r328/drivers/board/input/Kconfig
source arch/arm/src/r328/drivers/board/xradio/Kconfig
```

## arch/arm/src/r328/drivers/board/input/Kconfig
```kconfig
menuconfig DRIVERS_INPUT
	default n
	bool "Input driver"

if DRIVERS_INPUT
config INPUT_TEST_DEMO
	bool "Enable input test demo."
	default n

	source arch/arm/src/r328/drivers/board/input/keyboard/Kconfig

endif
```

## arch/arm/src/r328/drivers/board/input/keyboard/Kconfig
```kconfig
menuconfig DRIVERS_KEYBOARD
	default n
	bool "keyboard driver"

if DRIVERS_KEYBOARD

config DRIVERS_R328_KEYBOARD
	bool "enable lradc keyboard driver"
	default n

config DRIVERS_R328_GPADC_KEY
	bool "enable gpadc keyboard driver"
	default n

config DRIVERS_R328_GPIO_KEY
	bool "enable gpio keyboard driver"
	default n
endif
```
